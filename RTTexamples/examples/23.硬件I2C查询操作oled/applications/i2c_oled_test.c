/****************************2015-2016, NJUT, Edu.****************************** 
FileName: i2c_oled_test.c 
Author:  孙冬梅       Version :  1.0        Date: 2016.07.30
Description:    i2c_oled 驱动及测试程序 采用硬件I2C查询方式
              1.初始化基于I2C总线 的 oled（1306驱动）
              2.数据写入oled显示缓冲
              
Version:         1.0 
History:         
      <author>  <time>   <version >   <desc> 
      Sundm    16/07/30     1.0     文件创建   
********************************************************************************/ 

#include <rtthread.h>
#include  <finsh.h> 
#include "stm32f10x.h"	

#define OLED_ADDRESS 0x78 //oled 地址 0x78

const unsigned char  show[]=
{
/*------------------------------------------------------------------------------
;  若数据乱码，请检查字模格式设置，注意选择正确的取模方向和字节位顺序。
;  源文件 / 文字 : 中国江苏
;  宽×高（像素）: 128×64
;  字模格式/大小 : 单色点阵液晶字模，纵向取模，字节倒序/1024字节
;  数据转换日期  : 2016/8/21 10:13:25
------------------------------------------------------------------------------*/
0x00,0x00,0x00,0x00,0x00,0x00,0x00,0x00,0x00,0x00,0x00,0x00,0x00,0x00,0x00,0x00,
0x00,0x00,0x00,0x00,0x00,0x00,0x00,0x00,0x00,0x00,0x00,0x00,0x00,0x00,0x00,0x00,
0x00,0x00,0x00,0x00,0x00,0x00,0x00,0x00,0x00,0x00,0x00,0x00,0x00,0x00,0x00,0x00,
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0x00,0x00,0x00,0x00,0x00,0x00,0x00,0x00,0x00,0x00,0x00,0x00,0x00,0x00,0x00,0x00,

};

/*初始化oled 的数组*/
uint8_t initial_oled_data[28]={0xAE,0x20,0x10,0xb0,0xc8,0x00,0x10,0x40,0x81,0xdf,0xa1,0xa6,
0xa8,0x3F,0xa4,0xd3,0x00,0xd5,0xf0,0xd9,0x22,0xda,0x12,0xdb,0x20,0x8d,0x14,0xaf};


/*******************************************************************************
* Function Name  : IIC_oled_Configuration
* Description    : 初始化IIC2外设 oled
* Input          : None
* Output         : None
* Return         : None
*******************************************************************************/
void IIC_oled_Configuration(void)
{
  GPIO_InitTypeDef	 GPIO_InitStructure;
  I2C_InitTypeDef    I2C_InitStructure;

  /*打开时钟*/
  RCC_APB2PeriphClockCmd(RCC_APB2Periph_GPIOB,ENABLE);		 
  RCC_APB1PeriphClockCmd(RCC_APB1Periph_I2C1 ,ENABLE);  

  /*定义GPIO口为开漏输出 复用*/
  GPIO_InitStructure.GPIO_Pin = GPIO_Pin_6|GPIO_Pin_7; 	
  GPIO_InitStructure.GPIO_Speed = GPIO_Speed_50MHz;	
  GPIO_InitStructure.GPIO_Mode = GPIO_Mode_AF_OD;	
  GPIO_Init(GPIOB,&GPIO_InitStructure);			

  /*配置I2C*/
  I2C_InitStructure.I2C_ClockSpeed = 50000;          /*时钟频率400kHz */
  I2C_InitStructure.I2C_Mode = I2C_Mode_I2C;        
  I2C_InitStructure.I2C_DutyCycle = I2C_DutyCycle_2;  /*CCR寄存器占空比 50% */
  I2C_InitStructure.I2C_OwnAddress1 = 0xB0 ;         /*作为从机时的地址*/
  I2C_InitStructure.I2C_Ack = I2C_Ack_Enable;        /*应答使能 */
  I2C_InitStructure.I2C_AcknowledgedAddress = I2C_AcknowledgedAddress_7bit; /*7位地址*/
  I2C_Init(I2C1,&I2C_InitStructure);

  /*使能I2C*/
  I2C_Cmd(I2C1, ENABLE);
}

/*******************************************************************************
* Function Name  : IIC_oled_Buffer_Write
* Description    : 对oled的写buffer操作，是一段数据的写操作。
* Input          : data_addr 要写入数据的地址 len要写入数据的长度 mode 为0时 CMD 为1时 DATA
* Output         : None
* Return         : None 
*******************************************************************************/
void IIC_oled_Buffer_Write( uint8_t* data_addr, uint16_t len, uint8_t mode)
{
	
  I2C_GenerateSTART(I2C1, ENABLE); 
  while(!I2C_CheckEvent(I2C1,I2C_EVENT_MASTER_MODE_SELECT));
  
  I2C_Send7bitAddress(I2C1, OLED_ADDRESS, I2C_Direction_Transmitter); 
  while(!I2C_CheckEvent(I2C1,I2C_EVENT_MASTER_TRANSMITTER_MODE_SELECTED));                                                                          

  if(mode==0)
  {
    I2C_SendData(I2C1,0x00);  
  }
  else if(mode ==1)
  {
    I2C_SendData(I2C1,0x40);  
  }    	 
  while(!I2C_CheckEvent(I2C1,I2C_EVENT_MASTER_BYTE_TRANSMITTING)); 
  
  for(int i=0;i<len;i++)
  {																																 																															                                                                  
    I2C_SendData(I2C1,*data_addr++);                                    
    while(!I2C_CheckEvent(I2C1,I2C_EVENT_MASTER_BYTE_TRANSMITTED)); 
  }
  I2C_GenerateSTOP(I2C1,ENABLE);                                 
}

/*******************************************************************************
* Function Name  : fill_picture
* Description    : 对oled的画面填充
* Input          : fill_Data 要填充的数据 
* Output         : None
* Return         : None 
*******************************************************************************/
void fill_picture(uint8_t fill_Data)
{
  uint8_t cmd_buf[3] = {0xb0,0x00,0x10};
  uint8_t data_buf[128*8] = {0x00};
  
  /*将要填充的数据 填满数组*/
  for(int i=0;i<128*8;i++)
  {
    data_buf[i] = fill_Data;
  }
  
  IIC_oled_Buffer_Write(cmd_buf, 3, 0);
  IIC_oled_Buffer_Write(data_buf, 128*8, 1);   
}

/*******************************************************************************
* Function Name  : show_picture
* Description    : 在图面上显示 数据组show中的图像
* Input          : None
* Output         : None
* Return         : None 
*******************************************************************************/
void show_picture(void)
{
  u8 cmd_buf[3] = {0xb0,0x00,0x10};

  IIC_oled_Buffer_Write(cmd_buf, 3, 0);
  IIC_oled_Buffer_Write((uint8_t *)&show, 128*8, 1);	
}

/*******************************************************************************
* Function Name  : test_i2c_oled
* Description    : 
* Input          : None
* Output         : None
* Return         : None
*******************************************************************************/
void test_i2c_oled (void)
{
  IIC_oled_Configuration();
  /*用初始化数组 初始化 oled*/
  IIC_oled_Buffer_Write( initial_oled_data,28,0);
  /*显示一幅图像 “中国江苏”*/
  show_picture();
}

FINSH_FUNCTION_EXPORT(test_i2c_oled,  startup oled test e.g: test_i2c_oled()); 
FINSH_FUNCTION_EXPORT(fill_picture,  startup oled fill e.g: fill_picture(0xF0)); 
